/*
 * Copyright (c) 2021 Paranoid Android
 *
 * This program is free software; you can redistribute it and/or modify it
 * under the terms of the GNU General Public License version 2 as published by
 * the Free Software Foundation.
 */

/dts-v1/;
/plugin/;

#include "kona-mtp.dtsi"

/ {
	model = "ROG Phone 3";
	compatible = "qcom,kona-mtp", "qcom,kona", "qcom,mtp";
	qcom,board-id = <40 0>;
};
