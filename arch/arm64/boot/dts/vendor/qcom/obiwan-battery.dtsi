/*
 * Copyright (c) 2021 Paranoid Android
 *
 * This program is free software; you can redistribute it and/or modify it
 * under the terms of the GNU General Public License version 2 as published by
 * the Free Software Foundation.
 */

&vendor {
	obiwan_batterydata: qcom,battery-data {
		qcom,batt-id-range-pct = <15>;
		#include "fg-gen4-batterydata-5800mah_4p35V.dtsi"
	};
};

&pm8150b_charger {
	qcom,battery-data = <&obiwan_batterydata>;
};

&pm8150b_fg {
	qcom,battery-data = <&obiwan_batterydata>;
};
